## CMakeLists.txt
```
cmake_minimum_required(VERSION 3.20.0)

find_package(Zephyr REQUIRED HINTS $ENV{ZEPHYR_BASE})
project(eriscv_m2_zephyr_low_power)

target_sources(app PRIVATE src/main.c)
```

## prj.conf
```kconfig
# Dedicated low-power smoke profile. Keep console traffic out of the idle
# interval so the only expected wake source is the Zephyr CLINT timeout.
CONFIG_TICKLESS_KERNEL=y
CONFIG_ERISCV_MCU_WFI_CLOCK_GATING=y
CONFIG_CONSOLE=n
CONFIG_PRINTK=n
CONFIG_UART_CONSOLE=n
CONFIG_ERISCV_UART_IRQ_CONSOLE=n
CONFIG_MAIN_STACK_SIZE=1024
```

## src/main.c
```c
/* Zephyr tickless idle smoke: CLINT timeout wakes controller-gated WFI. */

#include <zephyr/kernel.h>
#include <zephyr/sys/atomic.h>

#define ZEPHYR_RESULT_PASS 0x5a6b7c8du
#define ZEPHYR_RESULT_FAIL 0xdead0010u

volatile unsigned int eriscv_zephyr_result __attribute__((section(".noinit")));

K_SEM_DEFINE(wake_sem, 0, 1);

static atomic_t wake_count;
static struct k_timer wake_timer;

static void wake_timer_expiry(struct k_timer *timer)
{
	ARG_UNUSED(timer);
	atomic_inc(&wake_count);
	k_sem_give(&wake_sem);
}

int main(void)
{
	eriscv_zephyr_result = 0u;
	k_timer_init(&wake_timer, wake_timer_expiry, NULL);
	k_timer_start(&wake_timer, K_MSEC(1), K_NO_WAIT);

	/* Blocking here leaves only Zephyr's idle thread runnable; arch_cpu_idle()
	 * executes WFI and the SoC controller gates the core clock. */
	if (k_sem_take(&wake_sem, K_MSEC(20)) == 0 &&
	    atomic_get(&wake_count) == 1) {
		eriscv_zephyr_result = ZEPHYR_RESULT_PASS;
	} else {
		eriscv_zephyr_result = ZEPHYR_RESULT_FAIL;
	}

	for (;;) {
		k_sleep(K_FOREVER);
	}
}
```
