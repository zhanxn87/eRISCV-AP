## sw/linux/eriscv_ap_eth/Kconfig
```kconfig
# SPDX-License-Identifier: GPL-2.0-only
config ERISCV_AP_ETH
	tristate "eRISCV-AP descriptor-ring Ethernet"
	depends on OF && HAS_DMA
	help
	  Driver for the AP Ethernet MAC, its non-coherent 48-bit AXI DMA path,
	  and the 32-byte DDR descriptor rings.
```

## sw/rtos/zephyr/boards/riscv/eriscv_mcu/Kconfig.board
```kconfig
# eRISCV-M2 board configuration
# Copyright (c) 2024 eRISCV-MCU Contributors
# SPDX-License-Identifier: Apache-2.0

config BOARD_ERISCV_MCU
	bool "eRISCV-M2 Board"
	depends on SOC_ERISCV_MCU
	help
	  eRISCV-M2 is the RV32IMFC product variant with PMP, standard B, Zicond, and Zcf.
	  It provides 128 KB ITCM, 128 KB DTCM, 512 KB System SRAM, DMA, UART,
	  GPIO, APB Timer, SPI, WDT, and a 32-source PLIC. The current Zephyr
	  profile intentionally uses the integer ISA subset until F task-context
	  save/restore is available.
```

## sw/rtos/zephyr/boards/riscv/eriscv_mcu/Kconfig.defconfig
```kconfig
# eRISCV-M2 board default Kconfig
# Copyright (c) 2024 eRISCV-MCU Contributors
# SPDX-License-Identifier: Apache-2.0

if BOARD_ERISCV_MCU

config BOARD
	default "eriscv_mcu"

config SOC
	default "eriscv_mcu"

# Use CLINT for timer
config RISCV_MACHINE_TIMER
	default y

# Minimal logging for debug
config LOG
	default n

endif # BOARD_ERISCV_MCU
```

## sw/rtos/zephyr/boards/riscv/eriscv_mcu/eriscv_mcu_defconfig
```kconfig
# eRISCV-M2 default config (Kconfig fragment)
# Minimal configuration for eRISCV-M2 Zephyr build

CONFIG_SOC_ERISCV_MCU=y
CONFIG_BOARD_ERISCV_MCU=y

CONFIG_SYS_CLOCK_TICKS_PER_SEC=1000
CONFIG_RISCV_MACHINE_TIMER=y

# Memory
CONFIG_SRAM_BASE_ADDRESS=0x11000000
CONFIG_SRAM_SIZE=128
CONFIG_FLASH_BASE_ADDRESS=0x10000000
CONFIG_FLASH_SIZE=128

# Console
CONFIG_CONSOLE=y
CONFIG_UART_CONSOLE=y
CONFIG_SERIAL=y
CONFIG_UART_NS16550=n

# Kernel
CONFIG_MULTITHREADING=y
CONFIG_NUM_COOP_PRIORITIES=4
CONFIG_NUM_PREEMPT_PRIORITIES=4
CONFIG_MAIN_THREAD_PRIORITY=0
CONFIG_MAIN_STACK_SIZE=4096
CONFIG_IDLE_STACK_SIZE=1024
CONFIG_ISR_STACK_SIZE=4096

# Synchronization
CONFIG_POLL=y

# Disable unused
CONFIG_LOG=n
CONFIG_PRINTK=y
```

## sw/rtos/zephyr/dts/bindings/counter/eriscv,timer0.yaml
```yaml
# Copyright (c) 2024 eRISCV-MCU Contributors
# SPDX-License-Identifier: Apache-2.0

description: eRISCV-MCU APB timer

compatible: "eriscv,timer0"

include: [base.yaml]

properties:
  reg:
    required: true
  interrupts:
    required: true
```

## sw/rtos/zephyr/dts/bindings/gpio/eriscv,gpio0.yaml
```yaml
# Copyright (c) 2024 eRISCV-MCU Contributors
# SPDX-License-Identifier: Apache-2.0

description: eRISCV-MCU GPIO controller

compatible: "eriscv,gpio0"

include: [gpio-controller.yaml, base.yaml]

properties:
  reg:
    required: true

  "#gpio-cells":
    const: 2

gpio-cells:
  - pin
  - flags
```

## sw/rtos/zephyr/dts/bindings/serial/eriscv,uart0.yaml
```yaml
# SPDX-License-Identifier: Apache-2.0

description: eRISCV-MCU UART0

compatible: "eriscv,uart0"

include: uart-controller.yaml

properties:
  reg:
    required: true
  clock-frequency:
    type: int
    required: true
  current-speed:
    type: int
    required: true
```

## sw/rtos/zephyr/dts/bindings/spi/eriscv,spi0.yaml
```yaml
# SPDX-License-Identifier: Apache-2.0

description: eRISCV-MCU SPI0 controller

compatible: "eriscv,spi0"

include: spi-controller.yaml

properties:
  reg:
    required: true
  interrupts:
    required: true
```

## sw/rtos/zephyr/dts/bindings/watchdog/eriscv,wdt0.yaml
```yaml
# Copyright (c) 2024 eRISCV-MCU Contributors
# SPDX-License-Identifier: Apache-2.0

description: eRISCV-MCU watchdog timer
compatible: "eriscv,wdt0"
include: [base.yaml]
properties:
  reg:
    required: true
  interrupts:
    required: true
```

## sw/rtos/zephyr/soc/riscv/eriscv_mcu/Kconfig.defconfig
```kconfig
# eRISCV-MCU SoC default configuration
# Copyright (c) 2024 eRISCV-MCU Contributors
# SPDX-License-Identifier: Apache-2.0

if SOC_ERISCV_MCU

config SOC
	default "eriscv_mcu"

config NUM_IRQS
	int
	default 32
	help
	  Number of PLIC interrupt sources on eRISCV-MCU.

config SYS_CLOCK_HW_CYCLES_PER_SEC
	int
	default 100000000
	help
	  System clock frequency in Hz (100 MHz).

config RISCV_ISA_EXT_M
	bool
	default y

config RISCV_ISA_EXT_C
	bool
	default y

endif # SOC_ERISCV_MCU
```

## sw/rtos/zephyr/soc/riscv/eriscv_mcu/Kconfig.series
```kconfig
# eRISCV-MCU SoC series configuration
# Copyright (c) 2024 eRISCV-MCU Contributors
# SPDX-License-Identifier: Apache-2.0

config SOC_SERIES_ERISCV_MCU
	bool "eRISCV-MCU Series"
	select RISCV
	select RISCV_PRIVILEGED
	select 32BIT
	select SOC_FAMILY_RISCV_PRIVILEGE
	help
	  eRISCV-MCU is an educational RISC-V MCU-class SoC series.

rsource "../eriscv_mcu/Kconfig.soc"
rsource "../eriscv_mcu/Kconfig.defconfig"
```

## sw/rtos/zephyr/soc/riscv/eriscv_mcu/Kconfig.soc
```kconfig
# eRISCV-MCU SoC configuration options
# Copyright (c) 2024 eRISCV-MCU Contributors
# SPDX-License-Identifier: Apache-2.0

config SOC_ERISCV_MCU
	bool "eRISCV-MCU SoC"
	select RISCV
	select RISCV_PRIVILEGED
	select RISCV_HAS_PLIC
	select 32BIT
	select ATOMIC_OPERATIONS_C
	select RISCV_ISA_RV32I
	select RISCV_ISA_EXT_M
	select RISCV_ISA_EXT_C
	select RISCV_ISA_EXT_ZICSR
	select RISCV_ISA_EXT_ZIFENCEI
	select INCLUDE_RESET_VECTOR
	help
	  eRISCV-M2 is an educational RV32IMFC MCU-class SoC with PMP, standard B,
	  Zicond, Zcf, DMA, and System SRAM. This Zephyr port selects the integer ISA
	  subset until its task-context save/restore supports F registers.

if SOC_ERISCV_MCU

config UART_ERISCV
	bool "eRISCV UART driver"
	default y
	depends on DT_HAS_ERISCV_UART0_ENABLED
	select SERIAL_HAS_DRIVER
	select SERIAL_SUPPORT_INTERRUPT

config UART_ERISCV_BAUD_DIVISOR
	int "eRISCV UART baud divisor"
	default 868
	range 1 4294967295
	depends on UART_ERISCV
	help
	  Peripheral-clock cycles per UART bit. The 100 MHz hardware clock uses
	  868 for 115200 baud. Simulation may override this with a smaller value.

config GPIO_ERISCV
	bool "eRISCV GPIO driver"
	default y
	depends on DT_HAS_ERISCV_GPIO0_ENABLED
	select GPIO
	select GPIO_HAS_DRIVER

config COUNTER_ERISCV
	bool "eRISCV APB timer driver"
	default y
	depends on DT_HAS_ERISCV_TIMER0_ENABLED
	select COUNTER

config WDT_ERISCV
	bool "eRISCV watchdog driver"
	default y
	depends on DT_HAS_ERISCV_WDT0_ENABLED
	select WDT

config SPI_ERISCV
	bool "eRISCV SPI controller driver"
	default y
	depends on DT_HAS_ERISCV_SPI0_ENABLED
	select SPI

config ERISCV_UART_IRQ_CONSOLE
	bool "eRISCV UART interrupt-driven console TX"
	default y
	depends on UART_ERISCV && UART_CONSOLE && UART_INTERRUPT_DRIVEN && PRINTK
	help
	  Replace the normal polling console TX hook after kernel startup with an
	  interrupt-driven UART TX ring buffer. The standard polling hook remains
	  active during early startup.

config ERISCV_MCU_WFI_CLOCK_GATING
	bool "Gate the core clock while Zephyr idle executes WFI"
	default n
	help
	  Enable CLK_RST.SLEEP_CTRL.WFI_SLEEP_EN during early SoC initialization.
	  Keep this disabled by default; applications should enable it only after
	  their wake-source and idle behavior have been validated.

endif # SOC_ERISCV_MCU
```
